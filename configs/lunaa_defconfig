## configs/lunaa_defconfig
```kconfig
CONFIG_POSITION_INDEPENDENT=y
CONFIG_LINUX_KRNL_HEADER_IMG=y
# CONFIG_COMPRESS_GZIP is not set
CONFIG_LIBFDT=y
CONFIG_SM7325=y
CONFIG_REALME_LUNAA=y
CONFIG_TEXT_BASE=0x83600000
CONFIG_PAYLOAD_ENTRY=0x90000000
CONFIG_RAMDISK_ENTRY=0xB0000000
CONFIG_FDT_BUF_ADDR=0x8FE00000
```
